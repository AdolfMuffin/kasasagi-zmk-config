## config/west.yml
```yaml
manifest:
  remotes:
    - name: zmkfirmware
      url-base: https://github.com/zmkfirmware
    - name: stellarboards
      url-base: https://github.com/stellarboards
  projects:
    - name: zmk
      remote: zmkfirmware
      revision: main
      import: app/west.yml
    - name: stellarboards-zmk-module
      remote: stellarboards
      revision: main
  self:
    path: config
```
